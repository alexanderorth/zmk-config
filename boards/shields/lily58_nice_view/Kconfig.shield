## boards/shields/lily58_nice_view/Kconfig.shield
```kconfig
config SHIELD_LILY58_NICE_VIEW
	def_bool $(shields_list_contains,lily58_nice_view)
```

## boards/shields/xiao_lily58_dongle/Kconfig.shield
```kconfig
config SHIELD_XIAO_LILY58_DONGLE
    def_bool $(shields_list_contains,xiao_lily58_dongle)
```

## boards/shields/xiao_sofle_dongle/Kconfig.defconfig
```kconfig
if SHIELD_XIAO_SOFLE_DONGLE

config ZMK_KEYBOARD_NAME
    default "Sofle Dongle"

config ZMK_SPLIT_ROLE_CENTRAL
    default y

endif
```

## boards/shields/xiao_sofle_dongle/Kconfig.shield
```kconfig
config SHIELD_XIAO_SOFLE_DONGLE
    def_bool $(shields_list_contains,xiao_sofle_dongle)
```
