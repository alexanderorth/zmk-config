## boards/shields/xiao_lily58_dongle/Kconfig.defconfig
```kconfig
if SHIELD_XIAO_LILY58_DONGLE

config ZMK_KEYBOARD_NAME
    default "Lily58 Dongle"

config ZMK_SPLIT_ROLE_CENTRAL
    default y

config ZMK_SPLIT_BATTERY_HID_REPORT
    bool "Expose left/right peripheral battery levels via a custom USB HID report"
    default y
    depends on ZMK_USB && ZMK_SPLIT_BLE_CENTRAL_BATTERY_LEVEL_FETCHING

endif
```
